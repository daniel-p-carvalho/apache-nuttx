## boards/mips/pic32mz/ev49n51a/Kconfig
```kconfig
#
# For a description of the syntax of this configuration file,
# see the file kconfig-language.txt in the NuttX tools repository.
#

if ARCH_BOARD_EV49N51A

config EV49N51A_PHY_INTERRUPT
	bool "LAN8720A interrupt on RK6"
	default n
	depends on PIC32MZ_ETHERNET
	select ARCH_PHY_INTERRUPT
	select PIC32MZ_GPIOIRQ
	select PIC32MZ_GPIOIRQ_PORTK
	---help---
		Use the LAN8720A nINT output as a link up/down interrupt (for
		example for NETINIT_MONITOR).  nINT reaches RK6 only through R309,
		which is not fitted on the EV49N51A, so select this option only if
		R309 is fitted or nINT is otherwise wired to RK6.

config EV49N51A_BRIDGE_BOOT
	bool "Start the Wi-Fi AP bridged to Ethernet at boot"
	default n
	depends on ETC_ROMFS && SYSTEM_WIFIBRIDGE
	---help---
		Install /etc/init.d/rcS that runs "wifibridge start".  The SSID,
		passphrase, channel and address are the SYSTEM_WIFIBRIDGE_*
		defaults, or the configuration saved with "wifibridge save".

endif # ARCH_BOARD_EV49N51A
```
